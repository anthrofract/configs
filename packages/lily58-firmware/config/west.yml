## packages/lily58-firmware/config/west.yml
```yaml
manifest:
  remotes:
    - name: zmkfirmware
      url-base: https://github.com/zmkfirmware
  projects:
    - name: zmk
      remote: zmkfirmware
      revision: 696744d5f27ff2ed014047407d5e259d27efe6aa  # main
      import: app/west.yml
  self:
    path: config
```
